## CMakeLists.txt
```
cmake_minimum_required(VERSION 3.20)
find_package(Zephyr REQUIRED HINTS $ENV{ZEPHYR_BASE})
project(papabench_zephyr)

target_include_directories(app PRIVATE
  ${CMAKE_CURRENT_SOURCE_DIR}/papabench/sw/include
  ${CMAKE_CURRENT_SOURCE_DIR}/papabench/sw/include/c
  ${CMAKE_CURRENT_SOURCE_DIR}/papabench/sw/var/include
  ${CMAKE_CURRENT_SOURCE_DIR}/papabench/sw/airborne/autopilot
  ${CMAKE_CURRENT_SOURCE_DIR}/papabench/sw/airborne/fly_by_wire/
  ${CMAKE_CURRENT_SOURCE_DIR}/src
)

target_compile_options(app PRIVATE
  -include ${CMAKE_CURRENT_SOURCE_DIR}/papabench/sw/var/include/airframe.h
  -include ${CMAKE_CURRENT_SOURCE_DIR}/papabench/sw/var/include/radio.h
)

target_sources(app PRIVATE

  src/main.c
  src/pb_port.c
  src/pb_sched.c

  papabench/sw/airborne/autopilot/mainloop.c
  papabench/sw/airborne/autopilot/main.c
  papabench/sw/airborne/autopilot/estimator.c
  papabench/sw/airborne/autopilot/nav.c
  papabench/sw/airborne/autopilot/pid.c
  papabench/sw/airborne/autopilot/if_calib.c

  papabench/sw/lib/c/math.c
  papabench/sw/lib/c/geometry.c
)
```

## prj.conf
```kconfig
CONFIG_LLVM_USE_LLD=y
CONFIG_COMPILER_RT_RTLIB=y

CONFIG_PRINTK=y
CONFIG_LOG=n
CONFIG_MAIN_STACK_SIZE=8192
CONFIG_HEAP_MEM_POOL_SIZE=8192
CONFIG_TIMING_FUNCTIONS=y
CONFIG_THREAD_NAME=y
CONFIG_ASSERT=y
```

## src/main.c
```c
#include <zephyr/kernel.h>
#include <zephyr/sys/printk.h>

extern int papabench_mainloop(void);

int main(void)
{
    uint32_t start = k_cycle_get_32();

    papabench_mainloop();

    uint32_t end = k_cycle_get_32();

    printf("cycles: %u\n", end - start);

    return 0;
}
```

## src/angles.h
```c
#pragma once

#define RadOfDeg(x) ((x) * 0.01745329252)
#define DegOfRad(x) ((x) * 57.29577951)
```

## src/avr_stub.c
```c
#pragma once

volatile unsigned int TCCR1A;
volatile unsigned int TCCR1B;
volatile unsigned int TCCR2;
volatile unsigned int TCNT1;
volatile unsigned int TCNT1L;
volatile unsigned int TIFR;
volatile unsigned int TIMSK;
volatile unsigned int OCR1A;

volatile unsigned int SPCR;
volatile unsigned int SPSR;
volatile unsigned int SPDR;

volatile unsigned int PORTB;

#define SPE 6
#define MSTR 4
#define SPR0 0
#define SPIF 7
#define SPIE 7
#define TOV2 6
#define OCF1A 4
#define OCIE1A 4

#define _BV(x) (1 << (x))

#define bit_is_set(reg, bit) ((reg) & (1 << (bit)))
#define sbi(reg, bit) ((reg) |= (1 << (bit)))
#define cbi(reg, bit) ((reg) &= ~(1 << (bit)))
```

## src/papabench_stubs.c
```c
#include <zephyr/kernel.h>

/* hardware init stubs */

void modem_init(void) {}
void adc_init(void) {}
void spi_init(void) {}
void link_fbw_init(void) {}
void gps_init(void) {}
void ir_init(void) {}
void fbw_init(void) {}

/* runtime stubs */

void periodic_task(void) {}
void parse_gps_msg(void) {}
void send_gps_pos(void) {}
void send_radIR(void) {}
void send_takeOff(void) {}
void radio_control_task(void) {}

int gps_msg_received = 0;
int link_fbw_receive_complete = 0;

/* estimator dependency */

double ir_rad_of_ir(double x) { return x; }
```

## src/pb_port.c
```c
/* pb_port.c */
#include "pb_port.h"
void pb_port_init(void) {}
```

## src/pb_port.h
```c
/* pb_port.h */
#pragma once
void pb_port_init(void);
```

## src/pb_sched.c
```c
#include "pb_sched.h"
void pb_sched_init(void) {}
```

## src/pb_sched.h
```c
#pragma once
void pb_sched_init(void);
```
