## CMakeLists.txt
```
cmake_minimum_required(VERSION 3.20)
find_package(Zephyr REQUIRED HINTS $ENV{ZEPHYR_BASE})
project(papabench_zephyr)

target_compile_definitions(app PRIVATE
  PAPABENCH_SINGLE=1
)

target_include_directories(app PRIVATE
  ${CMAKE_CURRENT_SOURCE_DIR}/src/
  ${CMAKE_CURRENT_SOURCE_DIR}/papabench/sw/include/
  ${CMAKE_CURRENT_SOURCE_DIR}/papabench/sw/var/include/
  ${CMAKE_CURRENT_SOURCE_DIR}/papabench/sw/airborne/autopilot/
  ${CMAKE_CURRENT_SOURCE_DIR}/papabench/sw/airborne/fly_by_wire/
)

target_compile_options(app PRIVATE
)

target_sources(app PRIVATE
  src/fake_hw.c

  papabench/sw/lib/c/math.c

  papabench/sw/airborne/autopilot/mainloop.c
  papabench/sw/airborne/autopilot/main.c
  papabench/sw/airborne/autopilot/gps_ubx.c
  papabench/sw/airborne/autopilot/modem.c
  papabench/sw/airborne/autopilot/spi.c
  papabench/sw/airborne/autopilot/nav.c
  papabench/sw/airborne/autopilot/infrared.c
  papabench/sw/airborne/autopilot/estimator.c
  papabench/sw/airborne/autopilot/if_calib.c
  papabench/sw/airborne/autopilot/pid.c
  papabench/sw/airborne/autopilot/link_fbw.c
  papabench/sw/airborne/autopilot/adc.c
  papabench/sw/airborne/autopilot/uart.c

  papabench/sw/airborne/fly_by_wire/main.c
  papabench/sw/airborne/fly_by_wire/ppm.c
  papabench/sw/airborne/fly_by_wire/servo.c
  papabench/sw/airborne/fly_by_wire/spi.c
  papabench/sw/airborne/fly_by_wire/adc_fbw.c
  papabench/sw/airborne/fly_by_wire/uart.c
)

set_source_files_properties(
  papabench/sw/airborne/autopilot/link_fbw.c
  papabench/sw/airborne/autopilot/spi.c
  papabench/sw/airborne/autopilot/adc.c
  PROPERTIES COMPILE_DEFINITIONS "SIGNAL_PREFIX=ap_"
)

set_source_files_properties(
  papabench/sw/airborne/fly_by_wire/ppm.c
  papabench/sw/airborne/fly_by_wire/servo.c
  papabench/sw/airborne/fly_by_wire/spi.c
  papabench/sw/airborne/fly_by_wire/adc_fbw.c
  PROPERTIES COMPILE_DEFINITIONS "SIGNAL_PREFIX=fbw_"
)
```

## prj.conf
```kconfig
CONFIG_LLVM_USE_LLD=y
CONFIG_COMPILER_RT_RTLIB=y

CONFIG_USERSPACE=y
CONFIG_FPU=y
CONFIG_FPU_SHARING=y

# CONFIG_SYS_CLOCK_TICKS_PER_SEC=1000
CONFIG_COMPILER_OPT="-O2"
```

## src/main.c
```c
#include <zephyr/pm/device.h>

extern void autopilot_main(void);

int main(void)
{
    while (1) {
        autopilot_main();
        k_sleep(K_MSEC(10));
    }
}
```

## src/fake_hw.c
```c
#include "fake_hw.h"

volatile uint8_t ADMUX;
volatile uint8_t ACSR;
volatile uint8_t ADCW;
volatile uint8_t ADC;
volatile uint8_t ADCL;
volatile uint8_t ADCH;
volatile uint8_t ADCSR;
volatile uint8_t ADCSRA;

volatile uint8_t DDRA;
volatile uint8_t DDRB;
volatile uint8_t DDRC;
volatile uint8_t DDRD;
volatile uint8_t DDRF;
volatile uint8_t DDRE;
volatile uint8_t DDRG;

volatile uint8_t EICRA;
volatile uint8_t EICRB;
volatile uint8_t EIFR;
volatile uint8_t EIMSK;
volatile uint8_t ETIFR;
volatile uint8_t ETIMSK;

volatile uint8_t TIFR;
volatile uint8_t TIMSK;

volatile uint8_t ASSR;
volatile uint8_t TCCR0;
volatile uint8_t TCCR2;

volatile uint8_t TCCR1A;
volatile uint8_t TCCR1B;
volatile uint8_t TCCR1C;
volatile uint8_t TCCR3A;
volatile uint8_t TCCR3B;
volatile uint8_t TCCR3C;

volatile uint8_t OCR0;
volatile uint8_t OCR2;
volatile uint8_t OCR1A;
volatile uint8_t OCR1AL;
volatile uint8_t OCR1AH;
volatile uint8_t OCR1B;
volatile uint8_t OCR1BL;
volatile uint8_t OCR1BH;
volatile uint8_t OCR1C;
volatile uint8_t OCR1CL;
volatile uint8_t OCR1CH;
volatile uint8_t OCR3A;
volatile uint8_t OCR3AL;
volatile uint8_t OCR3AH;
volatile uint8_t OCR3B;
volatile uint8_t OCR3BL;
volatile uint8_t OCR3BH;
volatile uint8_t OCR3C;
volatile uint8_t OCR3CL;
volatile uint8_t OCR3CH;

volatile uint8_t TCNT0;
volatile uint8_t TCNT1;
volatile uint8_t TCNT1L;
volatile uint8_t TCNT1H;
volatile uint8_t TCNT2;
volatile uint8_t TCNT3;
volatile uint8_t TCNT3L;
volatile uint8_t TCNT3H;

volatile uint8_t ICR1;
volatile uint8_t ICR1L;
volatile uint8_t ICR1H;
volatile uint8_t ICR3;
volatile uint8_t ICR3L;
volatile uint8_t ICR3H;

volatile uint8_t PINA;
volatile uint8_t PINB;
volatile uint8_t PINC;
volatile uint8_t PIND;
volatile uint8_t PINE;
volatile uint8_t PINF;
volatile uint8_t PING;

volatile uint8_t PORTA;
volatile uint8_t PORTB;
volatile uint8_t PORTC;
volatile uint8_t PORTD;
volatile uint8_t PORTE;
volatile uint8_t PORTF;
volatile uint8_t PORTG;

volatile uint8_t SPCR;
volatile uint8_t SPDR;
volatile uint8_t SPSR;

volatile uint8_t UBRR0H;
volatile uint8_t UBRR0L;
volatile uint8_t UBRRH;
volatile uint8_t UBRRL;
volatile uint8_t UBRR1L;
volatile uint8_t UBRR1H;
volatile uint8_t UCSR0A;
volatile uint8_t UCSR0B;
volatile uint8_t UCSR0C;
volatile uint8_t UCSRA;
volatile uint8_t UCSRB;
volatile uint8_t UCSRC;
volatile uint8_t UCSR1A;
volatile uint8_t UCSR1B;
volatile uint8_t UCSR1C;
volatile uint8_t UDR0;
volatile uint8_t UDR;
volatile uint8_t UDR1;

volatile uint8_t SFIOR;
volatile uint8_t WDTCR;
volatile uint8_t OCDR;
volatile uint8_t MCUSR;
volatile uint8_t MCUCSR;
volatile uint8_t MCUCR;
volatile uint8_t RAMPZ;
volatile uint8_t XDIV;
volatile uint8_t SPMCR;
volatile uint8_t SPMCSR;
volatile uint8_t XMCRB;
volatile uint8_t XMCRA;
volatile uint8_t OSCCAL;

volatile uint8_t TWBR;
volatile uint8_t TWSR;
volatile uint8_t TWAR;
volatile uint8_t TWDR;
volatile uint8_t TWCR;
```

## src/fake_hw.h
```c
#ifndef FAKE_HW_H
#define FAKE_HW_H

#include <zephyr/kernel.h>
#include <zephyr/sys_clock.h>
#include <stdint.h>

#define _SFR_BYTE(sfr) (sfr)
#define _BV(bit) (1 << (bit))

#define bit_is_set(sfr, bit) ((sfr) & _BV(bit))
#define bit_is_clear(sfr, bit) (!((sfr) & _BV(bit)))

/* I/O registers */

/* Input Pins, Port F */
extern volatile uint8_t PINF;

/* Input Pins, Port E */
extern volatile uint8_t PINE;

/* Data Direction Register, Port E */
extern volatile uint8_t DDRE;

/* Data Register, Port E */
extern volatile uint8_t PORTE;

/* ADC Data Register */
extern volatile uint8_t ADCW; /* for backwards compatibility */
#ifndef __ASSEMBLER__
extern volatile uint8_t ADC;
#endif
extern volatile uint8_t ADCL;
extern volatile uint8_t ADCH;

/* ADC Control and status register */
extern volatile uint8_t ADCSR;
extern volatile uint8_t ADCSRA; /* new name in datasheet (2467E-AVR-05/02) */

/* ADC Multiplexer select */
extern volatile uint8_t ADMUX;

/* Analog Comparator Control and Status Register */
extern volatile uint8_t ACSR;

/* USART0 Baud Rate Register Low */
extern volatile uint8_t UBRR0L;

/* USART0 Control and Status Register B */
extern volatile uint8_t UCSR0B;

/* USART0 Control and Status Register A */
extern volatile uint8_t UCSR0A;

/* USART0 I/O Data Register */
extern volatile uint8_t UDR0;

/* SPI Control Register */
extern volatile uint8_t SPCR;

/* SPI Status Register */
extern volatile uint8_t SPSR;

/* SPI I/O Data Register */
extern volatile uint8_t SPDR;

/* Input Pins, Port D */
extern volatile uint8_t PIND;

/* Data Direction Register, Port D */
extern volatile uint8_t DDRD;

/* Data Register, Port D */
extern volatile uint8_t PORTD;

/* Input Pins, Port C */
extern volatile uint8_t PINC;

/* Data Direction Register, Port C */
extern volatile uint8_t DDRC;

/* Data Register, Port C */
extern volatile uint8_t PORTC;

/* Input Pins, Port B */
extern volatile uint8_t PINB;

/* Data Direction Register, Port B */
extern volatile uint8_t DDRB;

/* Data Register, Port B */
extern volatile uint8_t PORTB;

/* Input Pins, Port A */
extern volatile uint8_t PINA;

/* Data Direction Register, Port A */
extern volatile uint8_t DDRA;

/* Data Register, Port A */
extern volatile uint8_t PORTA;

/* 0x1C..0x1F EEPROM */

/* Special Function I/O Register */
extern volatile uint8_t SFIOR;

/* Watchdog Timer Control Register */
extern volatile uint8_t WDTCR;

/* On-chip Debug Register */
extern volatile uint8_t OCDR;

/* Timer2 Output Compare Register */
extern volatile uint8_t OCR2;

/* Timer/Counter 2 */
extern volatile uint8_t TCNT2;

/* Timer/Counter 2 Control register */
extern volatile uint8_t TCCR2;

/* T/C 1 Input Capture Register */
extern volatile uint8_t ICR1;
extern volatile uint8_t ICR1L;
extern volatile uint8_t ICR1H;

/* Timer/Counter1 Output Compare Register B */
extern volatile uint8_t OCR1B;
extern volatile uint8_t OCR1BL;
extern volatile uint8_t OCR1BH;

/* Timer/Counter1 Output Compare Register A */
extern volatile uint8_t OCR1A;
extern volatile uint8_t OCR1AL;
extern volatile uint8_t OCR1AH;

/* Timer/Counter 1 */
extern volatile uint8_t TCNT1;
extern volatile uint8_t TCNT1L;
extern volatile uint8_t TCNT1H;

/* Timer/Counter 1 Control and Status Register */
extern volatile uint8_t TCCR1B;

/* Timer/Counter 1 Control Register */
extern volatile uint8_t TCCR1A;

/* Timer/Counter 0 Asynchronous Control & Status Register */
extern volatile uint8_t ASSR;

/* Output Compare Register 0 */
extern volatile uint8_t OCR0;

/* Timer/Counter 0 */
extern volatile uint8_t TCNT0;

/* Timer/Counter 0 Control Register */
extern volatile uint8_t TCCR0;

/* MCU Status Register */
extern volatile uint8_t MCUSR;
extern volatile uint8_t MCUCSR; /* new name in datasheet (2467E-AVR-05/02) */

/* MCU general Control Register */
extern volatile uint8_t MCUCR;

/* Timer/Counter Interrupt Flag Register */
extern volatile uint8_t TIFR;

/* Timer/Counter Interrupt MaSK register */
extern volatile uint8_t TIMSK;

/* External Interrupt Flag Register */
extern volatile uint8_t EIFR;

/* External Interrupt MaSK register */
extern volatile uint8_t EIMSK;

/* External Interrupt Control Register B */
extern volatile uint8_t EICRB;

/* RAM Page Z select register */
extern volatile uint8_t RAMPZ;

/* XDIV Divide control register */
extern volatile uint8_t XDIV;

/* 0x3D..0x3E SP */

/* 0x3F SREG */

/* Extended I/O registers */

/* Data Direction Register, Port F */
extern volatile uint8_t DDRF;

/* Data Register, Port F */
extern volatile uint8_t PORTF;

/* Input Pins, Port G */
extern volatile uint8_t PING;

/* Data Direction Register, Port G */
extern volatile uint8_t DDRG;

/* Data Register, Port G */
extern volatile uint8_t PORTG;

/* Store Program Memory Control and Status Register */
extern volatile uint8_t SPMCR;
extern volatile uint8_t SPMCSR; /* new name in datasheet (2467E-AVR-05/02) */

/* External Interrupt Control Register A */
extern volatile uint8_t EICRA;

/* External Memory Control Register B */
extern volatile uint8_t XMCRB;

/* External Memory Control Register A */
extern volatile uint8_t XMCRA;

/* Oscillator Calibration Register */
extern volatile uint8_t OSCCAL;

/* 2-wire Serial Interface Bit Rate Register */
extern volatile uint8_t TWBR;

/* 2-wire Serial Interface Status Register */
extern volatile uint8_t TWSR;

/* 2-wire Serial Interface Address Register */
extern volatile uint8_t TWAR;

/* 2-wire Serial Interface Data Register */
extern volatile uint8_t TWDR;

/* 2-wire Serial Interface Control Register */
extern volatile uint8_t TWCR;

/* Time Counter 1 Output Compare Register C */
extern volatile uint8_t OCR1C;
extern volatile uint8_t OCR1CL;
extern volatile uint8_t OCR1CH;

/* Timer/Counter 1 Control Register C */
extern volatile uint8_t TCCR1C;

/* Extended Timer Interrupt Flag Register */
extern volatile uint8_t ETIFR;

/* Extended Timer Interrupt Mask Register */
extern volatile uint8_t ETIMSK;

/* Timer/Counter 3 Input Capture Register */
extern volatile uint8_t ICR3;
extern volatile uint8_t ICR3L;
extern volatile uint8_t ICR3H;

/* Timer/Counter 3 Output Compare Register C */
extern volatile uint8_t OCR3C;
extern volatile uint8_t OCR3CL;
extern volatile uint8_t OCR3CH;

/* Timer/Counter 3 Output Compare Register B */
extern volatile uint8_t OCR3B;
extern volatile uint8_t OCR3BL;
extern volatile uint8_t OCR3BH;

/* Timer/Counter 3 Output Compare Register A */
extern volatile uint8_t OCR3A;
extern volatile uint8_t OCR3AL;
extern volatile uint8_t OCR3AH;

/* Timer/Counter 3 Counter Register */
extern volatile uint8_t TCNT3;
extern volatile uint8_t TCNT3L;
extern volatile uint8_t TCNT3H;

/* Timer/Counter 3 Control Register B */
extern volatile uint8_t TCCR3B;

/* Timer/Counter 3 Control Register A */
extern volatile uint8_t TCCR3A;

/* Timer/Counter 3 Control Register C */
extern volatile uint8_t TCCR3C;

/* USART0 Baud Rate Register High */
extern volatile uint8_t UBRR0H;

/* USART0 Control and Status Register C */
extern volatile uint8_t UCSR0C;

/* USART1 Baud Rate Register High */
extern volatile uint8_t UBRR1H;

/* USART1 Baud Rate Register Low*/
extern volatile uint8_t UBRR1L;

/* USART1 Control and Status Register B */
extern volatile uint8_t UCSR1B;

/* USART1 Control and Status Register A */
extern volatile uint8_t UCSR1A;

/* USART1 I/O Data Register */
extern volatile uint8_t UDR1;

/* USART1 Control and Status Register C */
extern volatile uint8_t UCSR1C;

extern volatile uint8_t UCSRC;
extern volatile uint8_t UBRRH;

extern volatile uint8_t UBRRL;
extern volatile uint8_t UCSRB;
extern volatile uint8_t UCSRA;
extern volatile uint8_t UDR;

#define URSEL   7
#define UMSEL   6
#define UPM1    5
#define UPM0    4
#define USBS    3
#define UCSZ1   2
#define UCSZ0   1
#define UCPOL   0

/* Interrupt vectors */
#define	_VECTORS_SIZE 140

/*
   The Register Bit names are represented by their bit number (0-7).
*/

/* 2-wire Control Register - TWCR */
#define    TWINT        7
#define    TWEA         6
#define    TWSTA        5
#define    TWSTO        4
#define    TWWC         3
#define    TWEN         2
#define    TWIE         0

/* 2-wire Address Register - TWAR */
#define    TWA6         7
#define    TWA5         6
#define    TWA4         5
#define    TWA3         4
#define    TWA2         3
#define    TWA1         2
#define    TWA0         1
#define    TWGCE        0

/* 2-wire Status Register - TWSR */
#define    TWS7         7
#define    TWS6         6
#define    TWS5         5
#define    TWS4         4
#define    TWS3         3
#define    TWPS1        1
#define    TWPS0        0

/* External Memory Control Register A - XMCRA */
#define    SRL2         6
#define    SRL1         5
#define    SRL0         4
#define    SRW01        3
#define    SRW00        2
#define    SRW11        1

/* External Memory Control Register B - XMCRA */
#define    XMBK         7
#define    XMM2         2
#define    XMM1         1
#define    XMM0         0

/* XDIV Divide control register - XDIV */
#define    XDIVEN       7
#define    XDIV6        6
#define    XDIV5        5
#define    XDIV4        4
#define    XDIV3        3
#define    XDIV2        2
#define    XDIV1        1
#define    XDIV0        0

/* RAM Page Z select register - RAMPZ */
#define     RAMPZ0      0

/* External Interrupt Control Register A - EICRA */
#define    ISC31        7
#define    ISC30        6
#define    ISC21        5
#define    ISC20        4
#define    ISC11        3
#define    ISC10        2
#define    ISC01        1
#define    ISC00        0

/* External Interrupt Control Register B - EICRB */
#define    ISC71        7
#define    ISC70        6
#define    ISC61        5
#define    ISC60        4
#define    ISC51        3
#define    ISC50        2
#define    ISC41        1
#define    ISC40        0

/* Store Program Memory Control Register - SPMCSR, SPMCR */
#define    SPMIE        7
#define    RWWSB        6
#define    RWWSRE       4
#define    BLBSET       3
#define    PGWRT        2
#define    PGERS        1
#define    SPMEN        0

/* External Interrupt MaSK register - EIMSK */
#define    INT7         7
#define    INT6         6
#define    INT5         5
#define    INT4         4
#define    INT3         3
#define    INT2         2
#define    INT1         1
#define    INT0         0

/* External Interrupt Flag Register - EIFR */
#define    INTF7        7
#define    INTF6        6
#define    INTF5        5
#define    INTF4        4
#define    INTF3        3
#define    INTF2        2
#define    INTF1        1
#define    INTF0        0

/* Timer/Counter Interrupt MaSK register - TIMSK */
#define    OCIE2        7
#define    TOIE2        6
#define    TICIE1       5
#define    OCIE1A       4
#define    OCIE1B       3
#define    TOIE1        2
#define    OCIE0        1
#define    TOIE0        0

/* Timer/Counter Interrupt Flag Register - TIFR */
#define    OCF2         7
#define    TOV2         6
#define    ICF1         5
#define    OCF1A        4
#define    OCF1B        3
#define    TOV1         2
#define    OCF0         1
#define    TOV0         0

/* Extended Timer Interrupt MaSK register - ETIMSK */
#define    TICIE3       5
#define    OCIE3A       4
#define    OCIE3B       3
#define    TOIE3        2
#define    OCIE3C       1
#define    OCIE1C       0

/* Extended Timer Interrupt Flag Register - ETIFR */
#define    ICF3         5
#define    OCF3A        4
#define    OCF3B        3
#define    TOV3         2
#define    OCF3C        1
#define    OCF1C        0

/* MCU general Control Register - MCUCR */
#define    SRE          7
#define    SRW          6
#define    SRW10        6       /* new name in datasheet (2467E-AVR-05/02) */
#define    SE           5
#define    SM1          4
#define    SM0          3
#define    SM2          2
#define    IVSEL        1
#define    IVCE         0

/* MCU Status Register - MCUSR, MCUCSR */
#define    JTD          7
#define    JTRF         4
#define    WDRF         3
#define    BORF         2
#define    EXTRF        1
#define    PORF         0

/* Timer/Counter Control Register (generic) */
#define    FOC          7
#define    WGM0         6
#define    COM1         5
#define    COM0         4
#define    WGM1         3
#define    CS2          2
#define    CS1          1
#define    CS0          0

/* Timer/Counter 0 Control Register - TCCR0 */
#define    FOC0         7
#define    WGM00        6
#define    COM01        5
#define    COM00        4
#define    WGM01        3
#define    CS02         2
#define    CS01         1
#define    CS00         0

/* Timer/Counter 2 Control Register - TCCR2 */
#define    FOC2         7
#define    WGM20        6
#define    COM21        5
#define    COM20        4
#define    WGM21        3
#define    CS22         2
#define    CS21         1
#define    CS20         0

/* Timer/Counter 0 Asynchronous Control & Status Register - ASSR */
#define    AS0          3
#define    TCN0UB       2
#define    OCR0UB       1
#define    TCR0UB       0

/* Timer/Counter Control Register A (generic) */
#define    COMA1        7
#define    COMA0        6
#define    COMB1        5
#define    COMB0        4
#define    COMC1        3
#define    COMC0        2
#define    WGMA1        1
#define    WGMA0        0

/* Timer/Counter 1 Control and Status Register A - TCCR1A */
#define    COM1A1       7
#define    COM1A0       6
#define    COM1B1       5
#define    COM1B0       4
#define    COM1C1       3
#define    COM1C0       2
#define    WGM11        1
#define    WGM10        0

/* Timer/Counter 3 Control and Status Register A - TCCR3A */
#define    COM3A1       7
#define    COM3A0       6
#define    COM3B1       5
#define    COM3B0       4
#define    COM3C1       3
#define    COM3C0       2
#define    WGM31        1
#define    WGM30        0

/* Timer/Counter Control and Status Register B (generic) */
#define    ICNC         7
#define    ICES         6
#define    WGMB3        4
#define    WGMB2        3
#define    CSB2         2
#define    CSB1         1
#define    CSB0         0

/* Timer/Counter 1 Control and Status Register B - TCCR1B */
#define    ICNC1        7
#define    ICES1        6
#define    WGM13        4
#define    WGM12        3
#define    CS12         2
#define    CS11         1
#define    CS10         0

/* Timer/Counter 3 Control and Status Register B - TCCR3B */
#define    ICNC3        7
#define    ICES3        6
#define    WGM33        4
#define    WGM32        3
#define    CS32         2
#define    CS31         1
#define    CS30         0

/* Timer/Counter Control Register C (generic) */
#define    FOCA         7
#define    FOCB         6
#define    FOCC         5

/* Timer/Counter 3 Control Register C - TCCR3C */
#define    FOC3A        7
#define    FOC3B        6
#define    FOC3C        5

/* Timer/Counter 1 Control Register C - TCCR1C */
#define    FOC1A        7
#define    FOC1B        6
#define    FOC1C        5

/* On-chip Debug Register - OCDR */
#define    IDRD         7
#define    OCDR7        7
#define    OCDR6        6
#define    OCDR5        5
#define    OCDR4        4
#define    OCDR3        3
#define    OCDR2        2
#define    OCDR1        1
#define    OCDR0        0

/* Watchdog Timer Control Register - WDTCR */
#define    WDCE         4
#define    WDE          3
#define    WDP2         2
#define    WDP1         1
#define    WDP0         0

/* Special Function I/O Register - SFIOR */
#define    TSM          7
#define    ADHSM        4
#define    ACME         3
#define    PUD          2
#define    PSR0         1
#define    PSR321       0

/* SPI Status Register - SPSR */
#define    SPIF         7
#define    WCOL         6
#define    SPI2X        0

/* SPI Control Register - SPCR */
#define    SPIE         7
#define    SPE          6
#define    DORD         5
#define    MSTR         4
#define    CPOL         3
#define    CPHA         2
#define    SPR1         1
#define    SPR0         0

/* USART Register C (generic) */
#define    UMSEL        6
#define    UPM1         5
#define    UPM0         4
#define    USBS         3
#define    UCSZ1        2
#define    UCSZ0        1
#define    UCPOL        0

/* USART1 Register C - UCSR1C */
#define    UMSEL1       6
#define    UPM11        5
#define    UPM10        4
#define    USBS1        3
#define    UCSZ11       2
#define    UCSZ10       1
#define    UCPOL1       0

/* USART0 Register C - UCSR0C */
#define    UMSEL0       6
#define    UPM01        5
#define    UPM00        4
#define    USBS0        3
#define    UCSZ01       2
#define    UCSZ00       1
#define    UCPOL0       0

/* USART Status Register A (generic) */
#define    RXC          7
#define    TXC          6
#define    UDRE         5
#define    FE           4
#define    DOR          3
#define    UPE          2
#define    U2X          1
#define    MPCM         0

/* USART1 Status Register A - UCSR1A */
#define    RXC1         7
#define    TXC1         6
#define    UDRE1        5
#define    FE1          4
#define    DOR1         3
#define    UPE1         2
#define    U2X1         1
#define    MPCM1        0

/* USART0 Status Register A - UCSR0A */
#define    RXC0         7
#define    TXC0         6
#define    UDRE0        5
#define    FE0          4
#define    DOR0         3
#define    UPE0         2
#define    U2X0         1
#define    MPCM0        0

/* USART Control Register B (generic) */
#define    RXCIE        7
#define    TXCIE        6
#define    UDRIE        5
#define    RXEN         4
#define    TXEN         3
#define    UCSZ         2
#define    UCSZ2        2       /* new name in datasheet (2467E-AVR-05/02) */
#define    RXB8         1
#define    TXB8         0

/* USART1 Control Register B - UCSR1B */
#define    RXCIE1       7
#define    TXCIE1       6
#define    UDRIE1       5
#define    RXEN1        4
#define    TXEN1        3
#define    UCSZ12       2
#define    RXB81        1
#define    TXB81        0

/* USART0 Control Register B - UCSR0B */
#define    RXCIE0       7
#define    TXCIE0       6
#define    UDRIE0       5
#define    RXEN0        4
#define    TXEN0        3
#define    UCSZ02       2
#define    RXB80        1
#define    TXB80        0

/* Analog Comparator Control and Status Register - ACSR */
#define    ACD          7
#define    ACBG         6
#define    ACO          5
#define    ACI          4
#define    ACIE         3
#define    ACIC         2
#define    ACIS1        1
#define    ACIS0        0

/* ADC Control and status register - ADCSRA */
#define    ADEN         7
#define    ADSC         6
#define    ADFR         5
#define    ADIF         4
#define    ADIE         3
#define    ADPS2        2
#define    ADPS1        1
#define    ADPS0        0

/* ADC Multiplexer select - ADMUX */
#define    REFS1        7
#define    REFS0        6
#define    ADLAR        5
#define    MUX4         4
#define    MUX3         3
#define    MUX2         2
#define    MUX1         1
#define    MUX0         0

/* Port A Data Register - PORTA */
#define    PA7       7
#define    PA6       6
#define    PA5       5
#define    PA4       4
#define    PA3       3
#define    PA2       2
#define    PA1       1
#define    PA0       0

/* Port A Data Direction Register - DDRA */
#define    DDA7         7
#define    DDA6         6
#define    DDA5         5
#define    DDA4         4
#define    DDA3         3
#define    DDA2         2
#define    DDA1         1
#define    DDA0         0

/* Port A Input Pins - PINA */
#define    PINA7        7
#define    PINA6        6
#define    PINA5        5
#define    PINA4        4
#define    PINA3        3
#define    PINA2        2
#define    PINA1        1
#define    PINA0        0

/* Port B Data Register - PORTB */
#define    PB7       7
#define    PB6       6
#define    PB5       5
#define    PB4       4
#define    PB3       3
#define    PB2       2
#define    PB1       1
#define    PB0       0

/* Port B Data Direction Register - DDRB */
#define    DDB7         7
#define    DDB6         6
#define    DDB5         5
#define    DDB4         4
#define    DDB3         3
#define    DDB2         2
#define    DDB1         1
#define    DDB0         0

/* Port B Input Pins - PINB */
#define    PINB7        7
#define    PINB6        6
#define    PINB5        5
#define    PINB4        4
#define    PINB3        3
#define    PINB2        2
#define    PINB1        1
#define    PINB0        0

/* Port C Data Register - PORTC */
#define    PC7       7
#define    PC6       6
#define    PC5       5
#define    PC4       4
#define    PC3       3
#define    PC2       2
#define    PC1       1
#define    PC0       0

/* Port C Data Direction Register - DDRC */
#define    DDC7         7
#define    DDC6         6
#define    DDC5         5
#define    DDC4         4
#define    DDC3         3
#define    DDC2         2
#define    DDC1         1
#define    DDC0         0

/* Port C Input Pins - PINC */
#define    PINC7        7
#define    PINC6        6
#define    PINC5        5
#define    PINC4        4
#define    PINC3        3
#define    PINC2        2
#define    PINC1        1
#define    PINC0        0

/* Port D Data Register - PORTD */
#define    PD7       7
#define    PD6       6
#define    PD5       5
#define    PD4       4
#define    PD3       3
#define    PD2       2
#define    PD1       1
#define    PD0       0

/* Port D Data Direction Register - DDRD */
#define    DDD7         7
#define    DDD6         6
#define    DDD5         5
#define    DDD4         4
#define    DDD3         3
#define    DDD2         2
#define    DDD1         1
#define    DDD0         0

/* Port D Input Pins - PIND */
#define    PIND7        7
#define    PIND6        6
#define    PIND5        5
#define    PIND4        4
#define    PIND3        3
#define    PIND2        2
#define    PIND1        1
#define    PIND0        0

/* Port E Data Register - PORTE */
#define    PE7       7
#define    PE6       6
#define    PE5       5
#define    PE4       4
#define    PE3       3
#define    PE2       2
#define    PE1       1
#define    PE0       0

/* Port E Data Direction Register - DDRE */
#define    DDE7         7
#define    DDE6         6
#define    DDE5         5
#define    DDE4         4
#define    DDE3         3
#define    DDE2         2
#define    DDE1         1
#define    DDE0         0

/* Port E Input Pins - PINE */
#define    PINE7        7
#define    PINE6        6
#define    PINE5        5
#define    PINE4        4
#define    PINE3        3
#define    PINE2        2
#define    PINE1        1
#define    PINE0        0

/* Port F Data Register - PORTF */
#define    PF7       7
#define    PF6       6
#define    PF5       5
#define    PF4       4
#define    PF3       3
#define    PF2       2
#define    PF1       1
#define    PF0       0

/* Port F Data Direction Register - DDRF */
#define    DDF7         7
#define    DDF6         6
#define    DDF5         5
#define    DDF4         4
#define    DDF3         3
#define    DDF2         2
#define    DDF1         1
#define    DDF0         0

/* Port F Input Pins - PINF */
#define    PINF7        7
#define    PINF6        6
#define    PINF5        5
#define    PINF4        4
#define    PINF3        3
#define    PINF2        2
#define    PINF1        1
#define    PINF0        0

/* Port G Data Register - PORTG */
#define    PG4       4
#define    PG3       3
#define    PG2       2
#define    PG1       1
#define    PG0       0

/* Port G Data Direction Register - DDRG */
#define    DDG4         4
#define    DDG3         3
#define    DDG2         2
#define    DDG1         1
#define    DDG0         0

/* Port G Input Pins - PING */
#define    PING4        4
#define    PING3        3
#define    PING2        2
#define    PING1        1
#define    PING0        0

/* Constants */
#define SPM_PAGESIZE 256
#define    RAMEND   0x10FF     /* Last On-Chip SRAM Location */
#define    XRAMEND  0xFFFF
#define    E2END    0x0FFF
#define    FLASHEND 0x1FFFF

#endif /* _AVR_IOM128_H_ */
```

## src/fake_signal.h
```c
#define FAKE_SIGNAL_CONCAT2(a,b) a##b
#define FAKE_SIGNAL_CONCAT(a,b) FAKE_SIGNAL_CONCAT2(a,b)

#ifndef SIGNAL_PREFIX
#define SIGNAL_PREFIX
#endif

#define SIGNAL(signame) void FAKE_SIGNAL_CONCAT(SIGNAL_PREFIX, signame)(void)
```

## src/papabench_stub.c
```c
void modem_init(void) {}
void adc_init(void) {}
void spi_init(void) {}
void link_fbw_init(void) {}
void gps_init(void) {}
void nav_init(void) {}
void ir_init(void) {}
void estimator_init(void) {}
void fbw_init(void) {}
```
