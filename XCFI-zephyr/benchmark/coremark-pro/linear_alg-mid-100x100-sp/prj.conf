## CMakeLists.txt
```
# SPDX-License-Identifier: Apache-2.0

cmake_minimum_required(VERSION 3.20.0)
find_package(Zephyr REQUIRED HINTS $ENV{ZEPHYR_BASE})
project(linear_alg-mid-100x100-sp)
add_compile_definitions(PROJECT_NAME="${PROJECT_NAME}")

target_sources(app PRIVATE src/linear_alg-mid-100x100-sp.c
    src/linpack.c
    src/inputs_f32.c

    src/mith/th_lib.c
    src/mith/mith_workload.c
    src/mith/mith_lib.c
    src/mith/th_bignum.c
    src/mith/th_rand.c

    src/mith/al/th_al.c
    src/mith/al/al_smp.c
    src/mith/al/al_single.c
)

target_compile_definitions(app PRIVATE
    USE_FP32=1
)
```

## prj.conf
```kconfig
CONFIG_LLVM_USE_LLD=y
CONFIG_COMPILER_RT_RTLIB=y

CONFIG_MAIN_STACK_SIZE=16384

CONFIG_FPU=y
CONFIG_FPU_SHARING=y

#CONFIG_SPEED_OPTIMIZATIONS=n # -O2
#CONFIG_SIZE_OPTIMIZATIONS=n # -Os

#CONFIG_COMPILER_OPT="-Oz -mno-outline"
CONFIG_COMPILER_OPT="-O2"
```

## src/inputs_f32.c
```c
/*
(C) 2014 EEMBC(R).  All rights reserved.                            

All EEMBC Benchmark Software are products of EEMBC 
and are provided under the terms of the EEMBC Benchmark License Agreements.  
The EEMBC Benchmark Software are proprietary intellectual properties of EEMBC and its Members 
and is protected under all applicable laws, including all applicable copyright laws.  
If you received this EEMBC Benchmark Software without having 
a currently effective EEMBC Benchmark License Agreement, you must discontinue use. 
Please refer to LICENSE.md for the specific license agreement that pertains to this Benchmark Software.
*/

#include "coremark-pro/mith/th_lib.h"
#include "linpack.h"
static linpack_params in_data[]={
/* dataset 0 */
	{	101,100,10,0,0,
	NULL,NULL,NULL,NULL,
	NULL,
	{0,0,0x00000000,0x00800001}/*1.000000119209289551e+00*/,
	{0,0,0x00000000,0x00800001}/*1.000000119209289551e+00*/,
	{0,-17,0x00000000,0x00c60000}/*1.180171966552734375e-05*/,
	{0,-23,0x00000000,0x00800000}/*1.192092895507812500e-07*/,
	{0,0,0x00000000,0x00800000}/*1.000000000000000000e+00*/,
	{0,0,0x00000000,0x00800000}/*1.000000000000000000e+00*/,
	{0,-1,0x00000000,0x00fdda2b}/*9.916102290153503418e-01*/,
	0,0,
	0x00000fff,NULL,MIN_ACC_BITS_FP,
	0.0,0.0,0.0,0.0,0.0,0.0,0.0},
/* dataset 1 */
	{	101,100,10,73686179,0,
	NULL,NULL,NULL,NULL,
	NULL,
	{0,0,0x00000000,0x00800001}/*1.000000119209289551e+00*/,
	{0,0,0x00000000,0x00800000}/*1.000000000000000000e+00*/,
	{0,-17,0x00000000,0x00d44000}/*1.265108585357666016e-05*/,
	{0,-23,0x00000000,0x00800000}/*1.192092895507812500e-07*/,
	{0,0,0x00000000,0x00800000}/*1.000000000000000000e+00*/,
	{0,0,0x00000000,0x00800000}/*1.000000000000000000e+00*/,
	{0,0,0x00000000,0x008a09cf}/*1.078424334526062012e+00*/,
	0,0,
	0x00000fff,NULL,MIN_ACC_BITS_FP,
	0.0,0.0,0.0,0.0,0.0,0.0,0.0},
/* dataset 2 */
	{	722,721,2,73686179,0,
	NULL,NULL,NULL,NULL,
	NULL,
	{0,-1,0x00000000,0x00fffff2}/*9.999991655349731445e-01*/,
	{0,-1,0x00000000,0x00fffff5}/*9.999993443489074707e-01*/,
	{0,-11,0x00000000,0x00a48800}/*6.276369094848632812e-04*/,
	{0,-23,0x00000000,0x00800000}/*1.192092895507812500e-07*/,
	{0,0,0x00000000,0x00800000}/*1.000000000000000000e+00*/,
	{0,0,0x00000000,0x00800000}/*1.000000000000000000e+00*/,
	{0,2,0x00000000,0x00ed58da}/*7.417096138000488281e+00*/,
	0,0,
	0x00000fff,NULL,MIN_ACC_BITS_FP,
	0.0,0.0,0.0,0.0,0.0,0.0,0.0},
/* dataset 3 */
	{	1000,999,2,73686179,0,
	NULL,NULL,NULL,NULL,
	NULL,
	{0,-1,0x00000000,0x00fffff0}/*9.999990463256835938e-01*/,
	{0,-1,0x00000000,0x00ffffe8}/*9.999985694885253906e-01*/,
	{0,-11,0x00000000,0x00b50500}/*6.905347108840942383e-04*/,
	{0,-23,0x00000000,0x00800000}/*1.192092895507812500e-07*/,
	{0,0,0x00000000,0x00800000}/*1.000000000000000000e+00*/,
	{0,0,0x00000000,0x00800000}/*1.000000000000000000e+00*/,
	{0,2,0x00000000,0x00bc62bc}/*5.887052536010742188e+00*/,
	0,0,
	0x00000fff,NULL,MIN_ACC_BITS_FP,
	0.0,0.0,0.0,0.0,0.0,0.0,0.0},
/* dataset 4 */
	{	101,100,10,73686179,0,
	NULL,NULL,NULL,NULL,
	NULL,
	{0,0,0x00000000,0x00800001}/*1.000000119209289551e+00*/,
	{0,0,0x00000000,0x00800000}/*1.000000000000000000e+00*/,
	{0,-17,0x00000000,0x00d44000}/*1.265108585357666016e-05*/,
	{0,-23,0x00000000,0x00800000}/*1.192092895507812500e-07*/,
	{0,0,0x00000000,0x00800000}/*1.000000000000000000e+00*/,
	{0,0,0x00000000,0x00800000}/*1.000000000000000000e+00*/,
	{0,0,0x00000000,0x008a09cf}/*1.078424334526062012e+00*/,
	0,0,
	0x00000fff,NULL,MIN_ACC_BITS_FP,
	0.0,0.0,0.0,0.0,0.0,0.0,0.0},
/* dataset 5 */
	{	51,50,10,73686179,0,
	NULL,NULL,NULL,NULL,
	NULL,
	{0,0,0x00000000,0x00800003}/*1.000000357627868652e+00*/,
	{0,-1,0x00000000,0x00fffffd}/*9.999998211860656738e-01*/,
	{0,-19,0x00000000,0x00f46c00}/*3.642169758677482605e-06*/,
	{0,-23,0x00000000,0x00800000}/*1.192092895507812500e-07*/,
	{0,0,0x00000000,0x00800000}/*1.000000000000000000e+00*/,
	{0,0,0x00000000,0x00800000}/*1.000000000000000000e+00*/,
	{0,-1,0x00000000,0x009ef5e8}/*6.209397315979003906e-01*/,
	0,0,
	0x00000fff,NULL,MIN_ACC_BITS_FP,
	0.0,0.0,0.0,0.0,0.0,0.0,0.0}
}; //ref input data

void init_presets_linpack() {
	int idx;
	for (idx=0; idx<NUM_DATAS; idx++) {
		th_memcpy(&(presets_linpack[idx]),&(in_data[idx]),sizeof(linpack_params));
		presets_linpack[idx].ref_data=&(in_data[idx]);
	}
}
```

## src/linear_alg-mid-100x100-sp.c
```c
/* Created with: ../xml/linear_alg-mid-100x100-sp.xml */
/* common */
#include "coremark-pro/mith/th_lib.h"
#include "coremark-pro/mith/mith_workload.h"
#include "coremark-pro/mith/al/al_smp.h"

/* helper function to initialize a workload item */
ee_work_item_t *helper_linearalgmid100x100sp(ee_workload *workload, void *params, char *name, void * (*init_func)(void *), e_u32 repeats_override,
			void * (*bench_func)(struct TCDef *,void *), int (*cleanup)(void *), void * (*fini_func)(void *), int (*veri_func)(void *), int ncont,
			e_u32 kernel_id, e_u32 instance_id) {
	ee_work_item_t *item;
	if (params==NULL) {
		th_exit(1,"Error when trying to define benchmark params");
	}
	item=mith_item_init(repeats_override);
	item->params=params;
	if (th_strlen(name)>(MITH_MAX_NAME-1)) {
		th_strncpy(item->shortname,name,MITH_MAX_NAME-1);
		item->shortname[MITH_MAX_NAME-1]='\0';
	}
	else
		th_strcpy(item->shortname,name);
	item->init_func=init_func;
	item->fini_func=fini_func;
	item->veri_func=veri_func;
	item->bench_func=bench_func;
	item->cleanup=cleanup;
	item->num_contexts=ncont;
	item->kernel_id=kernel_id;
	item->instance_id=instance_id;
	mith_wl_add(workload,item);
	return item;
}
/* generated function types for each work item */
/* linear_alg-mid */
extern void *define_params_linpack(unsigned int idx, char *name, char *dataset);
extern void *bmark_init_linpack(void *);
extern void *bmark_fini_linpack(void *);
extern void *t_run_test_linpack(struct TCDef *,void *);
extern int bmark_verify_linpack(void *);
extern int bmark_clean_linpack(void *);

/* main function to create the workload, run it, and report results */
int main(int argc, char *argv[])
{
	char name[MITH_MAX_NAME];
	char dataname_buf[MITH_MAX_NAME];
	char *dataname;
	char *hardware_desc;
	int orig_dataname=1;
	void *retval;
	unsigned i;
	/* default values */
	e_u32 num_contexts=1;
	e_u32 num_workers=0;
	e_u32 bench_repeats=1;
	e_u32 oversubscribe_allowed=1;
	ee_work_item_t **real_items;
	ee_workload *workload;

	argc = 2;
	char *fake_argv[] = {"-v0", "-i1"};
	argv = fake_argv;

	/* first do abstraction layer specific initalizations */
	al_main(argc,argv);

	/* now prepare workload */
	workload = mith_wl_init(1); /* num items extracted from xml: sum(item*instances) for all items */
	real_items = (ee_work_item_t **)th_malloc(sizeof(ee_work_item_t *)*1);
	th_strncpy(workload->shortname,"linear_alg-mid-100x100-sp",MITH_MAX_NAME);
	workload->rev_M=1;
	workload->rev_m=1;
	workload->uid=1046644201;
	workload->iterations=50;

	/* parse command line for overrides
	   overrides for num_iterations, num_contexts,
	   and bench iterations for all items */
	{ e_s32 stmp;
	th_parse_flag_unsigned(argc,argv,"-i",&workload->iterations);
	th_parse_flag_unsigned(argc,argv,"-c",&num_contexts);
	th_parse_flag_unsigned(argc,argv,"-w",&num_workers);
	th_parse_flag_unsigned(argc,argv,"-b",&bench_repeats);
	th_parse_flag_unsigned(argc,argv,"-o",&oversubscribe_allowed);
	th_parse_flag_unsigned(argc,argv,"-v",&verify_output);
	th_parse_flag_unsigned(argc,argv,"-V",&reporting_threshold);
	if (th_parse_flag(argc,argv,"-pgo=",&stmp)) 
		pgo_training_run=stmp;
	}
	if (th_get_flag(argc,argv,"-D=",&dataname))
		orig_dataname=0;
	else
		dataname=dataname_buf;
	/* check command line for hardware specific information */
	if (th_get_flag(argc,argv,"-P=",&hardware_desc)) {
		al_set_hardware_info(hardware_desc);
	}

	/* SG/Test: make sure we have enough iterations to engage all contexts at least once */
	while (num_contexts > (workload->iterations * 1))
		workload->iterations++;
	
/* ITEM 0-0 [0]*/
	th_strncpy(name,"linear_alg-mid",MITH_MAX_NAME);
	if (orig_dataname) {
		th_strncpy(dataname,"100x100",MITH_MAX_NAME);
	}
	retval=define_params_linpack(4,name,dataname);
	real_items[0]=helper_linearalgmid100x100sp(workload,retval,name,bmark_init_linpack,bench_repeats,t_run_test_linpack,bmark_clean_linpack,bmark_fini_linpack,bmark_verify_linpack,1,(e_u32)1542051343,(e_u32)1128020447);

	/* Run the workload */
	mith_main(workload,workload->iterations,num_contexts,oversubscribe_allowed,num_workers);
	/* And cleanup */
	th_free(real_items);
	for (i=0; i<workload->max_idx ; i++) {
		ee_work_item_t *item=workload->load[i];
		item->cleanup(item->params);
	}
	mith_wl_destroy(workload);
	workload=NULL;
return 0;
}
```

## src/linpack.h
```c
/*
(C) 2014 EEMBC(R).  All rights reserved.                            

All EEMBC Benchmark Software are products of EEMBC 
and are provided under the terms of the EEMBC Benchmark License Agreements.  
The EEMBC Benchmark Software are proprietary intellectual properties of EEMBC and its Members 
and is protected under all applicable laws, including all applicable copyright laws.  
If you received this EEMBC Benchmark Software without having 
a currently effective EEMBC Benchmark License Agreement, you must discontinue use. 
Please refer to LICENSE.md for the specific license agreement that pertains to this Benchmark Software.
*/

#ifndef _LINPACK_H_
#define _LINPACK_H_


#define ZERO FPCONST(0.0)
#define ONE FPCONST(1.0)

typedef struct linpack_params_s {
	/* Benchmark setup */
	e_u32 lda; 	//Leading dimension
	e_u32 n;	 	//Matrix size
	e_u32 ntimes; //Number of matrixes to solve
	e_u32 seed;
	e_s32 gen_ref;

	/* Per init data */
	e_fp *a;
	e_fp *b; 
	e_u16 *ipvt;
	void *r; //for random;
	
	/* Verification and return values */
	struct linpack_params_s *ref_data;
	intparts iret_lda,iret_ldaa; /* return value so computation cannot be optimized away */
	intparts iresid,ieps,ix0,ixn,iresidn; /* for verification */
	e_u32 min_snr;
	e_u32 max_snr;
	
	e_u32 random_mask;
	e_fp *random_values;
	e_u32 minbits;

	e_fp ret_lda,ret_ldaa; /* return value so computation cannot be optimized away */
	e_fp resid,eps,x0,xn,residn; /* for verification */
} linpack_params;

/* When adding new data, replace "index" with current NUM_DATAS in generated data,	*
 * add proto and call init_preset_NUM_DATAS in init, and increase NUM_DATAS by 1	*/
#define NUM_DATAS 6
extern linpack_params presets_linpack[NUM_DATAS];
void init_presets_linpack();

#endif
```
